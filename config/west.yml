## config/west.yml
```yaml
manifest:
  remotes:
    - name: zmkfirmware
      url-base: https://github.com/zmkfirmware
  projects:
    - name: zmk
      remote: zmkfirmware
      revision: 6b44d33db2f4bad7d98e475e6f7968493b05af73
      import: app/west.yml
  self:
    path: config
```
